## arch/sandbox/Kconfig
```kconfig
config SANDBOX
	bool
	default y

config BOARDINFO
	string
	default "sandbox"

config ARCH_LINUX
	bool

source common/Kconfig
source drivers/Kconfig
```

## drivers/i2c/Kconfig
```kconfig
config DRIVER_TEST
	bool "test i2c driver"
	help
	  This option enables support for the test chip.

config DRIVER_TEST1
	bool "test1 i2c driver"
	help
	  This option enables support for the test chip.

config DRIVER_STUB
	bool "i2c-stub driver"
	help
	  This option enables support for the i2c-stub driver.
```
